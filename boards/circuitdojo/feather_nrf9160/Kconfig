## boards/circuitdojo/feather_nrf9160/Kconfig
```kconfig
config CIRCUITDOJO_FEATHER_NRF9160_STATIC_PARTITIONS_FACTORY
    bool "Use the static parition defintitions to stay compatible with bootloader"
    default y
```

## boards/circuitdojo/feather_nrf9160/board.yml
```yaml
board:
  name: circuitdojo_feather_nrf9160
  vendor: circuitdojo
  socs:
    - name: nrf9160
      variants:
        - name: "ns"
  revision:
    format: number
    default: "6"
    revisions:
      - name: "6"
```

## boards/test/cd_test_board/Kconfig.cd_test_board
```kconfig
# Copyright (c) 2016 Nordic Semiconductor ASA
# SPDX-License-Identifier: Apache-2.0

config BOARD_CD_TEST_BOARD
	select SOC_NRF52840_QIAA
```
